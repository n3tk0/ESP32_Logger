## tools/bootloader/sdkconfig.defaults.esp32
```kconfig
# ESP-IDF sdkconfig defaults for ESP32 (Xtensa) rollback-enabled bootloader
# Used by the GitHub Actions CI to build bootloader.bin

# === Core: rollback support ===
CONFIG_BOOTLOADER_APP_ROLLBACK_ENABLE=y

# === Bootloader optimization ===
CONFIG_BOOTLOADER_COMPILER_OPTIMIZATION_SIZE=y
CONFIG_BOOTLOADER_LOG_LEVEL_WARN=y

# === Flash ===
CONFIG_ESPTOOLPY_FLASHSIZE_4MB=y
CONFIG_ESPTOOLPY_FLASHMODE_DIO=y
CONFIG_ESPTOOLPY_FLASHFREQ_40M=y

# === Partition table ===
CONFIG_PARTITION_TABLE_CUSTOM=y
CONFIG_PARTITION_TABLE_CUSTOM_FILENAME="partitions_balanced.csv"

# === Target ===
CONFIG_IDF_TARGET="esp32"
```

## tools/bootloader/sdkconfig.defaults.esp32c3_supermini
```kconfig
# ESP-IDF sdkconfig defaults for ESP32-C3 Super Mini rollback-enabled bootloader
# Used by the GitHub Actions CI to build bootloader.bin
#
# Only bootloader-relevant options are set here. The rest use IDF defaults.

# === Core: rollback support ===
CONFIG_BOOTLOADER_APP_ROLLBACK_ENABLE=y

# === Bootloader optimization ===
CONFIG_BOOTLOADER_COMPILER_OPTIMIZATION_SIZE=y
CONFIG_BOOTLOADER_LOG_LEVEL_WARN=y

# === Flash ===
CONFIG_ESPTOOLPY_FLASHSIZE_4MB=y
CONFIG_ESPTOOLPY_FLASHMODE_DIO=y
CONFIG_ESPTOOLPY_FLASHFREQ_80M=y

# === Partition table ===
CONFIG_PARTITION_TABLE_CUSTOM=y
CONFIG_PARTITION_TABLE_CUSTOM_FILENAME="partitions_balanced.csv"

# === Target ===
CONFIG_IDF_TARGET="esp32c3"

# === USB Console (Important for Super Mini native USB JTAG/Serial) ===
CONFIG_ESP_CONSOLE_USB_SERIAL_JTAG=y
```
